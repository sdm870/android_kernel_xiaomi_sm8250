## drivers/input/fingerprint/goodix/Kconfig
```kconfig
# SPDX-License-Identifier: GPL-2.0-only

config FINGERPRINT_GOODIX
	tristate "GOODIX fingerprint sensor IRQ support"
	depends on INPUT_FINGERPRINT
	help
		If you say yes here you get IRQ support for the GOODIX family
		of fingerprint sensors from Goodix (GDX).
```

## drivers/input/fingerprint/goodix_fod/Kconfig
```kconfig
# SPDX-License-Identifier: GPL-2.0-only

config FINGERPRINT_GOODIX_FOD
	tristate "GOODIX fingerprint sensor IRQ support"
	depends on INPUT_FINGERPRINT
	help
		If you say yes here you get IRQ support for the GOODIX family
		of fingerprint sensors from Goodix (GDX).
```

## drivers/input/touchscreen/focaltech_spi/Kconfig
```kconfig
#
# Focaltech Touchscreen driver configuration
#

config TOUCHSCREEN_FOCALTECH
    tristate "Focaltech Touchscreen"
    default n
    help
      Say Y here if you have Focaltech touch panel.

      If unsure, say N.

      To compile this driver as a module, choose M here: the
      module will be called focaltech_touch.

config TOUCHSCREEN_SUPPORT_NEW_GAME_MODE
    tristate "Touch Support New Game Mode"
    default n
    help
      Say Y here if the device support new game mode

      If not support, say N.

config TOUCHSCREEN_FOCALTECH_TEST
    bool "Focaltech Touchscreen Test"
    depends on TOUCHSCREEN_FOCALTECH
    default n
    help
      Say Y here if you have Focaltech touch panel test.
      If unsure, say N.

config TOUCHSCREEN_FOCALTECH_ESDCHECK
    bool "Focaltech Touchscreen ESD Check"
    depends on TOUCHSCREEN_FOCALTECH
    default n
    help
      Say Y here if you have Focaltech touch panel esd check.
      If unsure, say N.

config TOUCHSCREEN_FOCALTECH_POINT_REPORT_CHECK
    bool "Focaltech Touchscreen ESD Check"
    depends on TOUCHSCREEN_FOCALTECH
    default n
    help
      Say Y here if you have Focaltech touch panel point report
      check.

      If unsure, say N.

config TOUCHSCREEN_FOCALTECH_DIRECTORY
    string "Focaltech ts directory name"
    default "focaltech_touch"
    depends on TOUCHSCREEN_FOCALTECH
```

## drivers/input/touchscreen/focaltech_touch/Kconfig
```kconfig
#
# Focaltech Touchscreen driver configuration
#

config TOUCHSCREEN_FTS
	tristate "Focaltech Touchscreen"
	depends on I2C
	default n
	help
		Say Y here if you have Focaltech touch panel.
		If unsure, say N.

config TOUCHSCREEN_FTS_FOD
	bool "Touch Support New Game Mode"
	depends on TOUCHSCREEN_FTS
	default n
	help
		Say Y here if the device support new game mode

		If not support, say N.

config TOUCHSCREEN_FTS_TEST
	bool "Focaltech Touchscreen Test"
	depends on TOUCHSCREEN_FTS
	default n
	help
		Say Y here if you have Focaltech touch panel test.
		If unsure, say N.

config TOUCHSCREEN_FTS_ESDCHECK
	bool "Focaltech Touchscreen ESD Check"
	depends on TOUCHSCREEN_FTS
	default n
	help
		Say Y here if you have Focaltech touch panel esd check.
		If unsure, say N.

config TOUCHSCREEN_FTS_POINT_REPORT_CHECK
	bool "Focaltech Touchscreen ESD Check"
	depends on TOUCHSCREEN_FTS
	default n
	help
		Say Y here if you have Focaltech touch panel point report
		check.

		If unsure, say N.

config TOUCHSCREEN_FTS_DIRECTORY
	string "Focaltech ts directory name"
	default "focaltech_touch"
	depends on TOUCHSCREEN_FTS
```

## drivers/input/touchscreen/nt36672c/Kconfig
```kconfig
#
# Novatek NT36xxx touchscreen driver configuration
#
config TOUCHSCREEN_NT36xxx_HOSTDL_SPI
	tristate "Novatek NT36xxx host download SPI driver"
	select SPI_XIAOMI_TP
	help
	  Say Y here if you have a Novatek NT36xxx no flash touchscreen connected
	  to your system by SPI bus.

	  If unsure, say N.

config TOUCHSCREEN_NT36xxx_DEBUG_FS
	bool "Touch debug interface"
	depends on DEBUG_FS
	depends on TOUCHSCREEN_NT36xxx_HOSTDL_SPI
	help
	  Control IRQ,suspend,sensor,debug firmware,etc.

config TOUCHSCREEN_NT36xxx_DEBUG
	bool "NVT Debug"
	depends on TOUCHSCREEN_NT36xxx_HOSTDL_SPI
	default n
	help
	  Control Debugging variables

config TOUCHSCREEN_NT36xxx_MP
	bool "NVT MP"
	depends on TOUCHSCREEN_NT36xxx_HOSTDL_SPI
	default n
	help
	  Control NVT MP Selftesting

config TOUCHSCREEN_NT36xxx_MP_FROM_CSV
	bool "NVT MP Set Criteria from CSV"
	depends on TOUCHSCREEN_NT36xxx_MP
	default n
	help
	  MP Criteria from CSV

config TOUCHSCREEN_NT36xxx_MP_SAVE_FILE
	bool "NVT MP Save To File"
	depends on TOUCHSCREEN_NT36xxx_MP
	default n
	help
	  Control NVT MP Selftesting Safe to file
```
